## Business > Business Switches > PoE Switches > TL-SG3428MP/tplink/buildroot-marvell/board/marvell/common/marvell.its
```
/dts-v1/;

/ {
	description = "Linux kernel and FDT blob";
	#address-cells = <1>;
	
	images {
		kernel@1 {
			description = "Marvell Linux";
			data = /incbin/("./zImage");
			type = "kernel";
			arch = "arm";
			os = "linux";
			compression = "none";
			load = <0x02a00000>;
			entry = <0x02a00000>;
			hash@1 {
				algo = "crc32";
			};
		};
		
		fdt@1 {
			description = "Flattened Device Tree blob - msys-ac3-rd.dtb";
			data = /incbin/("./msys-ac3-rd.dtb");
			type = "flat_dt";
			arch = "arm";
			compression = "none";
			hash@1 {
				algo = "crc32";
			};
		};
		
		fdt@2 {
			description = "Flattened Device Tree blob - msys-ac3_tl-sg2210hp-m2.dtb";
			data = /incbin/("./msys-ac3_tl-sg2210hp-m2.dtb");
			type = "flat_dt";
			arch = "arm";
			compression = "none";
			hash@1 {
				algo = "crc32";
			};
		};
	};	
	
	configurations {
		default = "conf@1";
		conf@1 {
			description = "Boot Linux kernel with FDT blob 1";
			kernel = "kernel@1";
			fdt = "fdt@1";
		};
		
		conf@2 {
			description = "Boot Linux kernel with FDT blob 1";
			kernel = "kernel@1";
			fdt = "fdt@2";
		};		
	};
};
			
```

## Business > Omada SDN > Controllers > oc200/mv-sdk/mv-uboot/arch/arm/mach-mvebu/armada3700/Kconfig
```kconfig
menu "eFuse support"

config MVEBU_EFUSE_SUPPORT
	bool "eFuse support"
	depends on TARGET_MVEBU_ARMADA_37XX && CMD_MVEBU_EFUSE
	default n
	help
	  Choose this option to add support
	  for eFuse access driver and enable
	  mailbox for eFuse read/write actions

endmenu

config MVEBU_ECK
	bool "Support for MVEBU ECK board"
	default n
	help
	  Say Y here to add support mvebu eck board
```

## Business > Omada SDN > Controllers > oc200/mv-sdk/mv-uboot/arch/arm/mach-mvebu/armada8k/Kconfig
```kconfig
config MVEBU_OC300
	bool "Support for MVEBU OC300 board"
	default n
	help
	  Say Y here to add support mvebu OC300 board
```

## Business > Omada SDN > Controllers > oc200/mv-sdk/mv-uboot/configs/mvebu_eck-88f3720_defconfig
```kconfig
CONFIG_ARM=y
CONFIG_ARCH_MVEBU=y
CONFIG_SYS_MALLOC_F_LEN=0x2000
CONFIG_TARGET_MVEBU_ARMADA_37XX=y
CONFIG_MVEBU_SYS_INFO=y
CONFIG_MVEBU_ECK=y
CONFIG_FDT_OFFSET=0x380
CONFIG_FDT_SIZE=0x80
CONFIG_KERNEL_OFFSET=0x400
CONFIG_KERNEL_SIZE=0x8000
CONFIG_ROOTFS_OFFSET=0x10400
CONFIG_ROOTFS_SIZE=0x80000
CONFIG_DEFAULT_DEVICE_TREE="armada-3720-eck"
CONFIG_AHCI=y
# CONFIG_SYS_MALLOC_CLEAR_ON_INIT is not set
CONFIG_BOOTDELAY=1
CONFIG_SYS_CONSOLE_INFO_QUIET=y
CONFIG_ARCH_EARLY_INIT_R=y
CONFIG_BOARD_EARLY_INIT_F=y
CONFIG_HUSH_PARSER=y
CONFIG_SYS_PROMPT="Marvell>> "
CONFIG_AUTOBOOT_KEYED=y
CONFIG_AUTOBOOT_PROMPT="Press CTRL+B to abort autoboot in %d seconds\n"
CONFIG_AUTOBOOT_STOP_STR="\x2"
# CONFIG_CMD_IMLS is not set
# CONFIG_CMD_SAVEENV is not set
CONFIG_CMD_MEMTEST=y
# CONFIG_CMD_FLASH is not set
CONFIG_CMD_MMC=y
CONFIG_CMD_PART=y
CONFIG_CMD_SF=y
CONFIG_CMD_SPI=y
CONFIG_CMD_I2C=y
CONFIG_CMD_USB=y
# CONFIG_CMD_FPGA is not set
CONFIG_CMD_GPIO=y
# CONFIG_CMD_SETEXPR is not set
# CONFIG_CMD_NFS is not set
CONFIG_CMD_MII=y
CONFIG_CMD_PING=y
CONFIG_CMD_CACHE=y
CONFIG_CMD_TIME=y
CONFIG_CMD_MVEBU_BUBT=y
CONFIG_CMD_EXT4=y
CONFIG_CMD_EXT4_WRITE=y
CONFIG_CMD_FAT=y
CONFIG_CMD_FS_GENERIC=y
CONFIG_MAC_PARTITION=y
CONFIG_ISO_PARTITION=y
CONFIG_EFI_PARTITION=y
CONFIG_NET_RANDOM_ETHADDR=y
CONFIG_HTTPD=y
CONFIG_DM_SCSI=y
CONFIG_MVEBU_SCSI=y
CONFIG_BLOCK_CACHE=y
CONFIG_DM_GPIO=y
CONFIG_DM_I2C=y
CONFIG_MISC=y
CONFIG_DM_MMC=y
CONFIG_MMC_SDHCI=y
CONFIG_MMC_SDHCI_SDMA=y
CONFIG_MMC_SDHCI_XENON=y
CONFIG_SPI_FLASH=y
CONFIG_SPI_FLASH_GIGADEVICE=y
CONFIG_SPI_FLASH_MACRONIX=y
CONFIG_SPI_FLASH_SPANSION=y
CONFIG_SPI_FLASH_STMICRO=y
CONFIG_SPI_FLASH_WINBOND=y
CONFIG_AR8236_SWITCH=y
CONFIG_MVEBU_COMPHY_SUPPORT=y
CONFIG_PINCTRL=y
CONFIG_PINCTRL_ARMADA_37XX=y
CONFIG_DM_REGULATOR_FIXED=y
CONFIG_DM_REGULATOR_GPIO=y
# CONFIG_SPL_SERIAL_PRESENT is not set
CONFIG_DEBUG_UART=y
CONFIG_DEBUG_MVEBU_A3700_UART=y
CONFIG_DEBUG_UART_BASE=0xd0012000
CONFIG_DEBUG_UART_CLOCK=25804800
CONFIG_DEBUG_UART_SHIFT=2
CONFIG_DEBUG_UART_ANNOUNCE=y
CONFIG_MVEBU_A3700_UART=y
CONFIG_MVEBU_A3700_SPI=y
CONFIG_USB=y
CONFIG_DM_USB=y
CONFIG_USB_XHCI_HCD=y
CONFIG_USB_EHCI_HCD=y
CONFIG_USB_STORAGE=y
CONFIG_SHA1=y
CONFIG_SHA256=y
CONFIG_DKMGT=y
CONFIG_DKMGT_PARTITION_TABLE_BASE_ADDR=0x10000
CONFIG_PRODUCT_INFO="OC200 v1.0"
```

## Business > Omada SDN > Controllers > oc200/mv-sdk/mv-uboot/lib/dkmgt/Kconfig
```kconfig
config DKMGT
	bool "TP-Link dkmgt"
	help
	  TP-Link dkmgt used for firmware upgrade.

config DKMGT_PARTITION_TABLE_BASE_ADDR
	depends on DKMGT
	hex
	prompt "Set the partition table base address(see your partition.json for makeflash tool)"
	default 0x0

config PRODUCT_INFO
	depends on DKMGT
	string "Product Info"
	prompt "Set Product Info(is composed of product_name and product_version in device-info.json)"
	help
	  TP-Link dkmgt used for firmware upgrade.Check product-info is whether or not correct.
```

## Business > Omada SDN > Routers > ER7206/build_dir/target-mips64-octeon-linux-gnu-osg_pro_un_v1/linux-octeon/linux-3.10.49/drivers/net/ethernet/octeon/Kconfig
```kconfig
#
# Cavium network device configuration
#
config OCTEON_ETHERNET
	tristate "Cavium Inc. OCTEON Ethernet support"
	depends on CPU_CAVIUM_OCTEON
	select PHYLIB
	select MDIO_OCTEON
	select NET_VENDOR_OCTEON
	select OCTEON_ETHERNET_MEM
	select OCTEON_ETHERNET_COMMON
	select HW_FASTPATH_HOOK
	help
	  This driver supports the builtin ethernet ports on Cavium
	  Inc.' products in the Octeon family. This driver supports the
	  CN3XXX, CN5XXX, CN6XXX and CNF7XXX OCTEON processors.

	  To compile this driver as a module, choose M here.  The module
	  will be called octeon-ethernet.

config OCTEON_ETHERNET_MEM
	tristate
	depends on CPU_CAVIUM_OCTEON

config OCTEON_POW_ONLY_ETHERNET
	tristate "POW based internal only ethernet driver"
	depends on  CPU_CAVIUM_OCTEON
	depends on  OCTEON_ETHERNET
	help
	  This option enables a very simple ethernet driver for internal core
	  to core traffic. It relies on another driver, octeon-ethernet,
	  to perform all hardware setup. This driver's purpose is to supply
	  basic networking between different Linux images running on the same
	  chip. A single core loads the octeon-ethernet module, all other cores
	  load this driver. On load, the driver waits for some other core to
	  perform hardware setup.

config OCTEON_MGMT_ETHERNET
	tristate "Octeon Management port ethernet driver (CN5XXX, CN6XXX)"
	depends on  CAVIUM_OCTEON_SOC
	select PHYLIB
	select MDIO_OCTEON
	select NET_VENDOR_OCTEON
	select OCTEON_ETHERNET_COMMON
	default y
	---help---
	  This option enables the ethernet driver for the management
	  port on Cavium Networks' Octeon CN57XX, CN56XX, CN55XX,
	  CN54XX, CN52XX, and CN6XXX chips.

config NET_VENDOR_OCTEON
	bool

config OCTEON_ETHERNET_COMMON
	tristate

config HW_FASTPATH_HOOK
	bool
```

## Business > Omada SDN > Routers > ER7206/package/kernel/ethernet-driver/ag71xx/Config.in
```kconfig
choice
    prompt "choice soc type of this profile"
    default ATH79_SOC_QCA9558 
    depends on PACKAGE_kmod-ethernet
    help
      Select the SOC type of your board.

    config ATH79_SOC_QCA9558
        bool "QCA 955x"
        help
          WDR7500 etc.

    config ATH79_SOC_QCA9533
        bool "QCA 9533"
        help
          tl-wr841n-v9 fx300-v1 etc.

    config ATH79_SOC_QCA9531
        bool "QCA 9531"
        help
          WDR5300 etc.

    config ATH79_SOC_QCA9561
        bool "QCA 9561"
        help
          H69RT etc.

    config ATH79_SOC_QCA9563
        bool "QCA 9563"
		select ETHERNET_PACKET_MANGLE
        help
          H610RD etc.
endchoice

choice
    prompt "choice switch type of this profile"
    default RTL8367S 
    depends on PACKAGE_kmod-ethernet
    help
      Select the switch type of your board.

    config RTL8367S
        bool "RTL8367S"
        help
          TL-WVR1300Gv2 TL-WVR900G 4.0 TL-WVR450G 6.0 etc.

    config RTL8370MB
        bool "RTL8370MB"
        help
          TL-WVR458Gv2 etc.
endchoice

config AG71XX_PLC_CONNECTED_PORT
    int "the port number which connected to PLC for PLC products"
    default 0
    depends on PACKAGE_kmod-ethernet
    help
      this option is used to disable flow control of this port, if this 
      product has problem that PLC bootloader continue sending PAUSE frame 
      cause gmac tx timeout.
      default is 0 which means not enable this option, here assumed that PLC 
      connected port never use port 0.

config AG71XX_LAN_WAN_PHY_SWAP
    bool "connect phy0 directly to GMAC0 as WAN port"
    default n
    depends on PACKAGE_kmod-ethernet
    help
      this option is used for products which connect phy0 directly to GMAC0 as
	  WAN port. default is no since normally phy4 is used, and only set to yes
    	  if use phy0 instead of phy4. This feature is used only for QCA9561 now.
      attention: config with uboot feature together.

config AG71XX_S17_EXCHANGE_MAC06
    bool "exchange mac0 and mac6 for s17 switch"
    default n
    depends on PACKAGE_kmod-ethernet
    help
      this configuration is for h610rdv1, which serdes and mac0 rgmii is connected to
      ar8337, must swap mac0 and mac6 in order to let mac6 connect to rgmii.

config AG71XX_DISABLE_GMAC_RXFC
    bool "disable gmac rx flow control"
    default n
    depends on PACKAGE_kmod-ethernet
    help
      in qca956x, when switch buffer if full, gmac receive PAUSE frame often cause tx 
      timeout. Base on QCA Simon suggestion, disable GMAC rxfc will let frame dropped 
      by switch instead of gmac, which avoid the driver problem.

config AG71XX_DISABLE_GMAC_TXFC
    bool "disable gmac tx flow control"
    default n
    depends on PACKAGE_kmod-ethernet
    help
      wdr7500v5 has problem which large mount of igmp packets cause tx timeout, disable 
      GMAC tx flow control won't cause this problem.
```

## Business > Omada SDN > Routers > ER7206/target/linux/generic/files-3.10.14/drivers/net/phy/rtl8367s/Kconfig
```kconfig
config RTL8367S_PHY
	tristate "Driver for the Realtek RTL8367S switch"
	select SWCONFIG
	select ETHERNET_PACKET_MANGLE
```

## Business > Omada SDN > Routers > ER7206/target/linux/generic/files-3.10.49/drivers/net/phy/rtl8367s/Kconfig
```kconfig
config RTL8367S_PHY
	tristate "Driver for the Realtek RTL8367S switch"
	select SWCONFIG
	select ETHERNET_PACKET_MANGLE

config RTL8367S_PHY_LED_10010ACT
        default n
        bool "rtl8367s phy led 10M activity"
        depends on RTL8367S_PHY

config RTL8367S_PHY_LED_OSG_MODE_1
        default n
        bool "rtl8367s phy led split mode, group0 is 1000M speed, group1 is link/act."
        depends on RTL8367S_PHY
```

## Business > Omada SDN > Switches > TL-SX3016F/tplink/buildroot-marvell/tplink/Config.in
```kconfig
menu "TPLINK"

config BR2_TPLINK_BUILD_SYSTEM
	bool "TP-LINK Switch Software System"
	help
	  Enable this option if you want to build a switch software system for
	  your embedded device
	  
config BR2_TPLINK_PROJECT_NAME
    string "Project name"
    default "T1600G_28TS"
    help
        Configure the name of project to build.
		archive dir = src/archive/$(BR2_TPLINK_PROJECT_NAME).
		use 'make -f $(BR2_TPLINK_PROJECT_NAME).mk' to build sdk.
		macro -DTPLINK_$(BR2_TPLINK_PROJECT_NAME) will be add to build sdk & adapter.

config BR2_TPLINK_COM_SW
	bool "COMMON SOFTWARE"
	help
		Enable this opti if you want to build common software
		
config BR2_TPLINK_COM_SW_NAME
	string "Common software name"
	default ""
    help
        Configure the name of project to build common software.
		archive dir = src/archive/$(BR2_TPLINK_COM_SW_NAME).
		use 'make -f $(BR2_TPLINK_COM_SW_NAME).mk' to build sdk.
		macro -DTPLINK_$(BR2_TPLINK_COM_SW_NAME) will be add to build sdk & adapter.
		
config BR2_TPLINK_COM_SW_SWITCH_LIST
	string "Common software switch list"
	default ""
    help
        Configure the list of switches whitch support common software.

		
config BR2_TPLINK_SOURCE_DIR
	string "The Source Directory"
	default "$(TOPDIR)/../src"
	help
      Configure the source directory of project      

config BR2_TPLINK_IPV6
    bool "Include IPV6"
    default y
    help
        Enable the option if you want to enable IPV6 in your switch system.

config BR2_TPLINK_CFLAGS
	string "tplink global cflags"
	default "-D$(BR2_TPLINK_PROJECT_NAME)=1 $(BR2_TPLINK_CHIP_VENDOR_DEF) $(BR2_TPLINK_CHIP_PLATFORM_DEF) $(BR2_TPLINK_ARCH_DEF) $(BR2_TPLINK_ENDIAN_DEFS) $(BR2_TPLINK_INET6_DEF)"
	help
		Configure the global cflags of tplink.   

config BR2_TPLINK_ARCH_DEF
	string
	default "-D_CPU_ARCH=1 -D_CPU_ARCH_ARM=1" if BR2_arm || BR2_armeb
	default "-D_CPU_ARCH=2 -D_CPU_ARCH_MIPS=2" if BR2_mips || BR2_mips64 || BR2_mipsel || BR2_mips64el

config BR2_TPLINK_ENDIAN_DEFS
	string
	default "-D_LITTLE_ENDIAN=1234 -D_BIG_ENDIAN=4321 -D_BYTE_ORDER=4321" if BR2_ENDIAN = "BIG"
	default "-D_LITTLE_ENDIAN=1234 -D_BIG_ENDIAN=4321 -D_BYTE_ORDER=1234" if BR2_ENDIAN = "LITTLE"

config BR2_TPLINK_CHIP_VENDOR_DEF
	string
	default "-D_CHIP_VENDOR=1 -D_CHIP_VENDOR_BCM=1" if BR2_TPLINK_AD_BCM
	default "-D_CHIP_VENDOR=2 -D_CHIP_VENDOR_MARVELL=2" if BR2_TPLINK_AD_MARVELL
	default "-D_CHIP_VENDOR=3 -D_CHIP_VENDOR_RTK=3" if BR2_TPLINK_AD_REALTEK

config BR2_TPLINK_CHIP_PLATFORM_DEF
	string "Chip Platform"
	default "-D_CHIP_VENDOR_MARVELL_AC3"
	
config BR2_TPLINK_INET6_DEF
	string
	default "-D_INET6_SUPPORT=1" if BR2_TPLINK_IPV6
	default "-D_INET6_SUPPORT=0" if !BR2_TPLINK_IPV6

menu "Build SDK"
config BR2_TPLINK_SDK_DIR
	string "The Source Directory of SDK"
	default "/Project/Trunk/SDK"
	help
      Configure the source directory of SDK
source tplink/sdk/Config.in
endmenu

endmenu
```

## Business > Omada SDN > Switches > TL-SX3016F/tplink/buildroot-marvell/tplink/sdk/Config.in
```kconfig
config BR2_TPLINK_SDK
	bool "SDK"
	help
		Enable this option if you want to build SDK in your switch system

config BR2_TPLINK_SDK_DBG
	bool "SDK CLI Debug"
	help
		Enable SDK CLI application or process (for debugging)
```

## Home > Mesh WiFi > Deco > X5700/bcm675x/bcm963xx_router/bcmdrivers/opensource/misc/misc_button/Kconfig.autodetect
```kconfig
config BCM_MISC_BUTTON
	bool "Broadcom misc button support"
	depends on I2C
	default n
	help
	  Enable misc button

config BCM_MISC_BUTTON_IMPL
	int "Implementation index for sound driver"
	depends on BCM_MISC_BUTTON
	default 1 if MISC_BUTTON_AW9163
	default 2 if MISC_BUTTON_AW9136

config MISC_BUTTON_AW9163
	bool "AW9163"
	depends on BCM_MISC_BUTTON
	help
	  Say Y if you want to add support aw9163.

config MISC_BUTTON_AW9136
	bool "AW9136"
	depends on BCM_MISC_BUTTON
	help
	  Say Y if you want to add support aw9136.
```

## Home > Mesh WiFi > Deco > X5700/bcm675x/bcm963xx_router/bcmdrivers/opensource/misc/misc_led/Kconfig.autodetect
```kconfig
config BCM_MISC_LED
	bool "Broadcom misc led support"
	depends on I2C
	default n
	help
	  Enable misc led

config BCM_MISC_LED_IMPL
	int "Implementation index for sound driver"
	depends on BCM_MISC_LED
	default 1

config MISC_LED_SN3236
	bool "SN3236"
	depends on BCM_MISC_LED
	help
	  Say Y if you want to add support sn3236.
```

## Smart Home > Security Cameras > EC60/platform/Config.in
```kconfig
# Copyright (C) 2006-2013 OpenWrt.org
#
# This is free software, licensed under the GNU General Public License v2.
# See /LICENSE for more information.
#

mainmenu "OpenWrt Configuration"

config MODULES
	option modules
	bool
	default y

config HAVE_DOT_CONFIG
	bool
	default y


source "config/Config-build.in"

source "config/Config-devel.in"

source "config/Config-target.in"

source "config/Config-kernel.in"

source "config/Config-toolchain.in"

source "tmp/.config-package.in"
```
